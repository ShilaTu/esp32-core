## components/template/Kconfig
```kconfig
menu "Counter"
    menuconfig COUNTER_TEST_ENABLE
        bool "Enable unit test"
        default y
    if COUNTER_TEST_ENABLE
        config COUNTER_TEST_ENABLE_RESET
            bool "Reset"
            default y
        config COUNTER_TEST_ENABLE_INCREMENT
            bool "Increment"
            default y
        config COUNTER_TEST_ENABLE_DECREMENT
            bool "Decrement"
            default y
        config COUNTER_TEST_ENABLE_ADD
            bool "Add"
            default y
        config COUNTER_TEST_ENABLE_SUB
            bool "Sub"
            default y
    endif
endmenu
```

## lifesensor_ci/sdkconfig.defaults
```kconfig
CONFIG_ESP_TASK_WDT=n
CONFIG_ESP32_ULP_COPROC_ENABLED=y
CONFIG_ESP32_ULP_COPROC_RESERVE_MEM=256
CONFIG_FREERTOS_SUPPORT_STATIC_ALLOCATION=y
CONFIG_ESPTOOLPY_FLASHMODE_DOUT=y
CONFIG_FREERTOS_UNICORE=y
```

## parts/esp32-components/channel/Kconfig
```kconfig
menu "Channel"
    menuconfig CHANNEL_TEST_ENABLE
        bool "Enable unit test"
        default y
        select CHANNEL_INTERNAL_EXPORT_SYMBOLS
    if CHANNEL_TEST_ENABLE
        config CHANNEL_TEST_ENABLE_INIT
            bool "init"
            default y
        config CHANNEL_TEST_ENABLE_SETCONTEXT
            bool "setContext"
            default y
        config CHANNEL_TEST_ENABLE_SETCALLBACK
            bool "setCallback"
            default y
        config CHANNEL_TEST_ENABLE_REGISTER
            bool "register"
            default y
        config CHANNEL_TEST_ENABLE_UNREGISTER
            bool "unregister"
            default y
        config CHANNEL_TEST_ENABLE_SEND
            bool "send"
            default y
        config CHANNEL_TEST_ENABLE_BROADCAST_INIT
            bool "broadcast_init"
            default y
        config CHANNEL_TEST_ENABLE_BROADCAST_FINISHED
            bool "broadcast_finished"
            default y
        config CHANNEL_TEST_ENABLE_RESETROOT
            bool "resetRoot"
            default y
        config CHANNEL_TEST_QUEUE_CONSUMER
            bool "Channel queue"
            default y
        config CHANNEL_TEST_QUEUE_TIMEOUT
            bool "Channel queue timeout"
            default y
        config CHANNEL_TEST_QUEUE_LOOP
            bool "Channel queue timeout"
            default y
    endif
    config CHANNEL_INTERNAL_EXPORT_SYMBOLS
        bool "Export internal functions"
        default n
endmenu
```

## parts/esp32-components/telemetry/Kconfig
```kconfig
menu "Telemetry"
    menuconfig TELEMETRY_WIFI_ENABLE
        bool "Enable wifi"
        default y
    if TELEMETRY_WIFI_ENABLE
        config TELEMETRY_WIFI_SSID
            string "SSID"
            default "Test_SSID"
        config TELEMETRY_WIFI_PW
            string "PW"
            default "Test_PW"
    endif
    menuconfig TELEMETRY_NETWORK_ENABLE
        bool "Enable network"
        default y
    if TELEMETRY_NETWORK_ENABLE
        config TELEMETRY_NETWORK_SERVER_IP
            string "IP"
            default "127.0.0.1"
        config TELEMETRY_NETWORK_SERVER_PORT
            int "Port"
            default "4321"
    endif
endmenu
```

## sdkconfig.defaults
```kconfig
CONFIG_ESP32_ULP_COPROC_ENABLED=y
CONFIG_ESP32_ULP_COPROC_RESERVE_MEM=256
CONFIG_FREERTOS_SUPPORT_STATIC_ALLOCATION=y
```
